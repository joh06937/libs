## cmlib/Kconfig
```kconfig
# CMLib configurations

# Note that we must include the OS Kconfig options prior to including the
# testing ones, as the testing ones have some dependencies on the OS
rsource "Kconfig.compiler"
rsource "Kconfig.cpu"
rsource "Kconfig.os"
rsource "Kconfig.testing"
```

## cmlib/Kconfig.compiler
```kconfig
# CMLib compiler configurations

menu "Compiler"
    choice
        prompt "Compiler"
        default COMPILER_IAR
        help
            Select the compiler toolchain to use

        config COMPILER_IAR
            bool "IAR"

        config COMPILER_HOST
            bool "Host PC default"
    endchoice

    config COMPILER_NAME
        string
        default "IAR" if COMPILER_IAR
        default "Host" if COMPILER_HOST
        default "<unconfigured>"
        help
            The human-readable name of the selected toolchain

            This is a helper string configuration. This option should never be
            configured manually; it is automatically configured based on the
            various `COMPILER_X` options. It can be used, however, such as in
            debug message output.

    config COMPILER_ASM_EXE
        string "ASM compiler executable"
        default "iasmarm.exe" if COMPILER_IAR
        help
            Specify the executable file name of the assembler

    config COMPILER_C_EXE
        string "C compiler executable"
        default "iccarm.exe" if COMPILER_IAR
        default "gcc" if COMPILER_HOST
        help
            Specify the executable file name of the C compiler

    config COMPILER_CPP_EXE
        string "C++ compiler executable"
        default "iccarm.exe" if COMPILER_IAR
        default "g++" if COMPILER_HOST
        help
            Specify the executable file name of the C++ compiler

    config COMPILER_PATH
        string "Path to the compiler"
        help
            Specify path to the toolchain on the host file system

            If this option is not specified, the build environment's PATH will
            be relied on to find the executables.

    config COMPILER_C_STANDARD
        int "C compiler standard"
        default 99
        help
            Specify the C compiler standard

    config COMPILER_CPP_STANDARD
        int "C++ compiler standard"
        default 17
        help
            Specify the C++ compiler standard

    choice
        prompt "Compiler optimization level"
        default OPTIMIZATION_LEVEL_HIGH
        help
            Select the optimization level to use

        config OPTIMIZATION_LEVEL_OFF
            bool "Off"
        config OPTIMIZATION_LEVEL_LOW
            bool "Low"
        config OPTIMIZATION_LEVEL_MEDIUM
            bool "Medium"
        config OPTIMIZATION_LEVEL_HIGH
            bool "High"
        config OPTIMIZATION_LEVEL_HIGH_SIZE
            bool "High, size"
        config OPTIMIZATION_LEVEL_HIGH_SPEED
            bool "High, speed"
    endchoice

    config OPTIMIZATION_LEVEL_NAME
        string
        default "Off" if OPTIMIZATION_LEVEL_OFF
        default "Low" if OPTIMIZATION_LEVEL_LOW
        default "Medium" if OPTIMIZATION_LEVEL_MEDIUM
        default "High" if OPTIMIZATION_LEVEL_HIGH
        default "High Size" if OPTIMIZATION_LEVEL_HIGH_SIZE
        default "High Speed" if OPTIMIZATION_LEVEL_HIGH_SPEED
        default "<unconfigured>"
        help
            The human-readable name of the selected optimization level

            This is a helper string configuration. This option should never be
            configured manually; it is automatically configured based on the
            various `OPTIMIZATION_LEVEL_X` options. It can be used, however,
            such as in debug message output.
endmenu
```

## cmlib/Kconfig.cpu
```kconfig
# CMLib CPU configurations

menu "CPU"
    choice
        prompt "CPU selection"
        help
            Select the CPU to target

        config SOC_STM32H743XX
            bool "STM32H743"
            select CPU_ARCH_ARM
            select CPU_CORTEX_M7
            select SOC_FAMILY_STM32

        config SOC_HOST
            bool "Host CPU"
    endchoice

    config CPU_ARCH_ARM
        bool
        help
            The CPU architecture is ARM

            This is a helper configuration. This option should never be
            configured manually; it is automatically configured based on the
            selected SOC. It can be used, however, such as in configuring
            toolchain options or including source code to be built for a
            particular SOC.

    config CPU_CORTEX_M7
        bool
        help
            The CPU architecture is ARM Cortex-M7

            This is a helper configuration. This option should never be
            configured manually; it is automatically configured based on the
            selected SOC. It can be used, however, such as in configuring
            toolchain options or including source code to be built for a
            particular SOC.

    config SOC_FAMILY_STM32
        bool
        help
            The CPU family is STM32

            This is a helper configuration. This option should never be
            configured manually; it is automatically configured based on the
            selected SOC. It can be used, however, such as in configuring
            toolchain options or including source code to be built for a
            particular SOC.

    config SOC_FAMILY_NAME
        string
        default "STM32" if SOC_FAMILY_STM32
        help
            The human-readable name of the selected SOC family

            This is a helper configuration. This option should never be
            configured manually; it is automatically configured based on the
            selected SOC. It can be used, however, such as in debug message
            output.

    config SOC_NAME
        string
        default "STM32H743" if SOC_STM32H743XX
        help
            The human-readable name of the selected SOC

            This is a helper configuration. This option should never be
            configured manually; it is automatically configured based on the
            selected SOC. It can be used, however, such as in debug message
            output.

    config STM_HAL
        bool "STM HAL library"
        depends on SOC_FAMILY_STM32
        default y
        help
            Opt to use the STM HAL library appropriate for the chosen SOC

    config STM_HAL_LL_DRIVERS
        bool "STM HAL LL drivers"
        depends on STM_HAL
        default y
        help
            Opt to build the STM HAL LL driver sources

    config STM_HAL_DRIVERS
        bool "STM HAL drivers"
        depends on STM_HAL
        default n
        help
            Opt to build the STM HAL driver sources
endmenu
```

## cmlib/Kconfig.testing
```kconfig
# CMLib testing configurations

menu "Unit Testing"
    if COMPILER_HOST && OS_HOST
        config IS_TEST
            bool "This is a unit test project"
            help
                The current project is a test project being built on the host OS
                with the host's compiler
    endif

    if !IS_TEST
        config UNIT_TESTING
            bool "Build unit testing"
            default y
            help
                Select unit testing to be included in the build

                This option will include the testing infrastructure as a series
                of additional 'external' projects that will all be buildable as
                a CMake target separate from the primary app. This option on its
                own will only build the testing projects; it will not run the
                tests themselves. See `ALWAYS_RUN_UNIT_TESTING`.

                Note that this option is not available when the host OS is
                selected, as unit tests themselves do not get to further have
                their own unit testing sub-projects (which would very likely
                cause an infinite loop of unit test sub-projects).
    endif

    if UNIT_TESTING
        config RUN_UNIT_TESTING
            bool "Run unit testing when building the primary target"
            default n
            help
                Run the built tests when building the primary target

                If testing is selected via `UNIT_TESTING`, the tests will always
                be build when building the primary target, and running the unit
                testing will always be available as an additional target. Select
                this option, however, will tie the running of the testing to the
                primary target as a dependency.
    endif
endmenu
```

## testing/example1/Kconfig
```kconfig
# Example 1 unit test project Kconfig

mainmenu "Example 1 Unit Testing"

rsource "../../cmlib/Kconfig"
```

## testing/example2/Kconfig
```kconfig
# Example 2 unit test project Kconfig

mainmenu "Example 2 Unit Testing"

rsource "../../cmlib/Kconfig"
```

## testing/test1/Kconfig
```kconfig
# test1 unit test project Kconfig

mainmenu "test1 Unit Testing"

rsource "../../Kconfig"
```
